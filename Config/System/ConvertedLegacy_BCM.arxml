AUTOSAR XML (schema 4-2-1)
# Copyright (c) 2017 Vector Informatik GmbH.
# License is restricted to the usage with CBD1500710 (D05) for MSR_Vector_SLP4.
# Please contact Vector Informatik whenever you need further information concerning the license conditions.
standard types defined: sint8
package /VehicleProject
  system System
package /Cluster
  can cluster CAN00: protocol-name=CAN  # IndicatorsDB
    can physical channel CHNL: comm-connectors=CN_CAN00
      frame IndicatorStatus_oCAN00: id 0x20, from BCM, frame-length=1, can-addressing-mode=STANDARD
        pdu IndicatorStatus_oCAN00: length=1, minimum-delay=0, transmission-mode-false-timing=cyclic-timing={time-offset=0, time-period=0.1}, transmission-mode-true-timing=cyclic-timing={time-offset=0, time-period=0.1}, unused-bit-pattern=0
          signal IndStatus_oIndicatorStatus_oCAN00: start 0, 8 bit, little-endian, init-value=0, base-type=sint8, compu {-128..127=RANGE}, transfer-property=PENDING
package /ECU
  ecu instance BCM: associated-com-i-pdu-group=BCM_oCAN00_Tx
    can communication controller CT_CAN00
    can communication connector CN_CAN00: comm-controller=CT_CAN00
package /IPDUGroup
  i signal i pdu group BCM_oCAN00_Tx: communication-direction=OUT, i-signal-i-pdus=IndicatorStatus_oCAN00

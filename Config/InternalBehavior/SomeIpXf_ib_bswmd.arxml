AUTOSAR XML (schema 4-2-1)
package /MICROSAR/SomeIpXf_ib_bswmd/BswModuleDescriptions
  bsw module description SomeIpXf
    bsw internal behavior SomeIpXfBehavior

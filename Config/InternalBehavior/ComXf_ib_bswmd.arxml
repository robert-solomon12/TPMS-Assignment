AUTOSAR XML (schema 4-2-1)
package /MICROSAR/ComXf_ib_bswmd/BswModuleDescriptions
  bsw module description ComXf
    bsw internal behavior ComXfBehavior

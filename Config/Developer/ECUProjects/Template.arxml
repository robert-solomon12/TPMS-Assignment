AUTOSAR XML (schema 4-3-0)
package /VehicleProject
  system System
    root-software-compositions:
      root sw composition prototype EcuSwComposition: software-composition=ECU_Composition
package /ECUCompositionTypes
  composition sw component type ECU_Composition
    11 x component:
      CpCoLogicController: type=ctCoLogicController
      CpSaInitiatorFront: type=CtSaInit
      CpSaInitiatorRear: type=CtSaInit
      CpSaSensorFrontLeft: type=CtSaSensor
      CpSaSensorFrontRight: type=CtSaSensor
      CpSaSensorRearLeft: type=CtSaSensor
      CpSaSensorRearRight: type=CtSaSensor
      CpSaLEDFL: type=CtSaLED
      CpSaLEDFR: type=CtSaLED
      CpSaLEDRL: type=CtSaLED
      CpSaLEDRR: type=CtSaLED
    connect CpSaSensorRearRight.SPpRRSense -> CpCoLogicController.RPpRRSenseState
    connect CpSaSensorFrontLeft.SPpRRSense -> CpCoLogicController.RPpFLSenseState
    connect CpSaSensorFrontRight.SPpRRSense -> CpCoLogicController.RPpFRSenseState
    connect CpSaSensorRearLeft.SPpRRSense -> CpCoLogicController.RPpRLSenseState
    connect CpSaInitiatorFront.PpSenseStateFL -> CpSaSensorFrontLeft.RPpFRSense
    connect CpSaInitiatorFront.PpSenseStateFR -> CpSaSensorFrontRight.RPpFRSense
    connect CpSaInitiatorRear.PpSenseStateFR -> CpSaSensorRearRight.RPpFRSense
    connect CpSaInitiatorRear.PpSenseStateFL -> CpSaSensorRearLeft.RPpFRSense
    connect CpCoLogicController.PpLogSigF -> CpSaInitiatorFront.PpLogSig
    connect CpCoLogicController.PpLogSigR -> CpSaInitiatorRear.PpLogSig
    connect CpCoLogicController.PpLedStateFL -> CpSaLEDFL.RPpLedState
    connect CpCoLogicController.PpLedStateFR -> CpSaLEDFR.RPpLedState
    connect CpCoLogicController.PpLedStateRL -> CpSaLEDRL.RPpLedState
    connect CpCoLogicController.PpLedStateRR -> CpSaLEDRR.RPpLedState
package /EndToEndProtections
  end to end protection set EndToEndProtectionSet

AUTOSAR XML (schema 4-2-1)
package /InitialEcuC
  ecuc value collection InitialEcuC: ecuc-values=[Can, CanIf, CanSM, Com, ComM, EcuC, EcuM, PduR]
  module config Can
    CanConfigSet
      CT_CAN00_720e0a19 (CanController):
        CanControllerActivation = true
        CanControllerDefaultBaudrate = CanControllerBaudrateConfig
        CanControllerSystemRef = CT_CAN00
        CanWakeupSourceRef = EcuMCommonConfiguration/CAN00_f26020e5
        CanControllerBaudrateConfig
      CN_CAN00_720e0a19_Tx (CanHardwareObject): CanHandleType=BASIC, CanIdValue=0, CanObjectType=TRANSMIT, CanControllerRef=CanConfigSet/CT_CAN00_720e0a19
    CanGeneral: CanIndex=0
  module config CanIf
    Can (CanIfCtrlDrvCfg): CanIfCtrlDrvInitHohConfigRef=CanIfInitHohCfg, CanIfCtrlDrvNameRef=CanGeneral
      CT_CAN00_720e0a19 (CanIfCtrlCfg): CanIfCtrlCanCtrlRef=CanConfigSet/CT_CAN00_720e0a19
    CanIfInitCfg
      CanIfBufferCfg_0fb271d2 (CanIfBufferCfg): CanIfBufferSize=0, CanIfBufferHthRef=CanIfInitHohCfg/CN_CAN00_720e0a19_Tx  # CHNL
      CanIfInitHohCfg: CanIfInitRefCfgSet=CanConfigSet
        CN_CAN00_720e0a19_Tx (CanIfHthCfg): CanIfHthCanCtrlIdRef=Can/CT_CAN00_720e0a19, CanIfHthIdSymRef=CanConfigSet/CN_CAN00_720e0a19_Tx
      IndicatorStatus_oCAN00_Tx_3abd61be (CanIfTxPduCfg):
        CanIfTxPduCanId = 32
        CanIfTxPduCanIdType = STANDARD_CAN
        CanIfTxPduDlc = 1
        CanIfTxPduUserTxConfirmationName = PduR_CanIfTxConfirmation
        CanIfTxPduUserTxConfirmationUL = PDUR
        CanIfTxPduBufferRef = CanIfBufferCfg_0fb271d2
        CanIfTxPduRef = PT_IndicatorStatus_PP_IndicatorStatus_Tx_0fb271d2_cda9acf5
    CanIfPrivateCfg: CanIfPrivateSoftwareFilterType=LINEAR
    CanIfPublicCfg: CanIfPublicPnSupport=false
  module config CanSM
    CanSMConfiguration
      CHNL_f276589c (CanSMManagerNetwork): CanSMComMNetworkHandleRef=ComMConfigSet/CAN00_f26020e5
        CT_CAN00_720e0a19 (CanSMController): CanSMControllerId=Can/CT_CAN00_720e0a19
  module config Com
    ComConfig
      IndicatorStatus_oCAN00_3abd61be (ComIPdu):
        ComIPduDirection = SEND
        ComIPduType = NORMAL
        ComIPduGroupRef = BCM_oCAN00_Tx_fcef2243
        ComIPduSignalRef = IndStatus_44e64ca2
        ComPduIdRef = PT_IndicatorStatus_PP_IndicatorStatus_Tx_0fb271d2_cda9acf5
        ComTxIPdu: ComMinimumDelayTime=0, ComTxIPduUnusedAreasDefault=0
          ComTxModeFalse
            ComTxMode: ComTxModeMode=PERIODIC, ComTxModeTimeOffset=0, ComTxModeTimePeriod=0.1
          ComTxModeTrue
            ComTxMode: ComTxModeMode=PERIODIC, ComTxModeTimeOffset=0, ComTxModeTimePeriod=0.1
      BCM_oCAN00_Tx_fcef2243 (ComIPduGroup)
      IndStatus_44e64ca2 (ComSignal):
        ComBitPosition = 0
        ComBitSize = 8
        ComSignalEndianness = LITTLE_ENDIAN
        ComSignalInitValue = 0
        ComSignalType = SINT8
        ComTransferProperty = PENDING
        ComSystemTemplateSystemSignalRef = IndStatus
    ComGeneral
  module config ComM
    ComMConfigSet: ComMPncEnabled=false
      CAN00_f26020e5 (ComMChannel): ComMBusType=COMM_BUS_TYPE_CAN, ComMChannelId=0  # CN_CAN00
        ComMNetworkManagement: ComMNmVariant=NONE
        CHNL_f276589c (ComMUserPerChannel): ComMUserChannel=USR_CHNL_f276589c  # CN_CAN00
      USR_CHNL_f276589c (ComMUser): ComMUserIdentifier=0  # CN_CAN00
    ComMGeneral: ComMPncIdCounting=COMM_PNC_ID_COUNT_FROM_NM_MESSAGE, ComMPncSupport=false
  module config EcuC
    EcucPduCollection: PduIdTypeEnum=UINT8, PduLengthTypeEnum=UINT8
      PT_IndicatorStatus_PP_IndicatorStatus_Tx_0fb271d2_cda9acf5 (Pdu): PduLength=1, SysTPduToFrameMappingRef=IndicatorStatus  # IndicatorStatus_oCAN00
  module config EcuM
    EcuMConfiguration
      EcuMCommonConfiguration
        EcuMDriverInitListOne
        EcuMDriverRestartList
        CAN00_f26020e5 (EcuMWakeupSource): EcuMWakeupSourceId=5, EcuMComMChannelRef=ComMConfigSet/CAN00_f26020e5  # CN_CAN00
      EcuMFlexConfiguration: EcuMFlexModuleConfigurationRef=CanConfigSet
  module config PduR
    PduRGeneral
    PduRRoutingTables
      PduRRoutingTable
        Can_PT_IndicatorStatus_0fb271d2 (PduRRoutingPath)  # IndicatorStatus_oCAN00
          DST_Can_PT_IndicatorStatus_0fb271d2 (PduRDestPdu): PduRDestPduRef=PT_IndicatorStatus_PP_IndicatorStatus_Tx_0fb271d2_cda9acf5
          SRC_Can_PT_IndicatorStatus_0fb271d2 (PduRSrcPdu): PduRSrcPduRef=PT_IndicatorStatus_PP_IndicatorStatus_Tx_0fb271d2_cda9acf5

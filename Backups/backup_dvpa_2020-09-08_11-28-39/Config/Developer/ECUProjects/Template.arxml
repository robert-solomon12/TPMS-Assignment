AUTOSAR XML (schema 4-3-0)
package /ECUCompositionTypes
  composition sw component type ECU_Composition
package /EndToEndProtections
  end to end protection set EndToEndProtectionSet
package /Systems
  system Template
    root-software-compositions:
      root sw composition prototype EcuSwComposition: software-composition=ECU_Composition
